## board/technologic/ts7120/Kconfig
```kconfig
if TARGET_TS7120

config SYS_BOARD
       default "ts7120"

config SYS_VENDOR
       default "technologic"

config SYS_SOC
       default "mx6"

config SYS_CONFIG_NAME
       default "ts7120"

endif
```

## board/technologic/ts7250v3/Kconfig
```kconfig
if CONFIG_TARGET_TS7250V3

config SYS_BOARD
	default "ts7250v3"

config SYS_VENDOR
	default "technologic"

config SYS_CONFIG_NAME
	default "ts7250v3"

endif
```

## board/technologic/ts7553v2/Kconfig
```kconfig
if TARGET_TS7553V2

config SYS_BOARD
       default "ts7553v2"

config SYS_VENDOR
       default "technologic"

config SYS_SOC
       default "mx6"

config SYS_CONFIG_NAME
       default "ts7553v2"

endif
```

## configs/ts4100_defconfig
```kconfig
CONFIG_SYS_EXTRA_OPTIONS="IMX_CONFIG=board/technologic/ts4100/imximage.cfg,MX6UL"
CONFIG_ARM=y
CONFIG_TARGET_TS4100=y
CONFIG_DM=y
CONFIG_DM_THERMAL=y
CONFIG_NET_RANDOM_ETHADDR=y
CONFIG_CMD_GPIO=y
CONFIG_CMD_DHCP=y
CONFIG_CMD_PING=y
CONFIG_SYS_PROMPT="U-Boot > "
```

## configs/ts4900-q-4g-1000mhz-c_defconfig
```kconfig
CONFIG_SYS_EXTRA_OPTIONS="IMX_CONFIG=board/technologic/ts4900/ts4900-q-4g-1000mhz-c.cfg,MX6Q,DDR_MB=3840,IMX_TYPE=\"ts4900-q-4g-1000mhz-c\""
CONFIG_ARM=y
CONFIG_TARGET_TS4900=y
CONFIG_DM=y
CONFIG_DM_THERMAL=y
```

## configs/ts4900-s-1g-1000mhz-c_defconfig
```kconfig
CONFIG_SYS_EXTRA_OPTIONS="IMX_CONFIG=board/technologic/ts4900/ts4900-s-1g-1000mhz-c.cfg,MX6DL,DDR_MB=1024,IMX_TYPE=\"ts4900-s-1g-1000mhz-c\""
CONFIG_ARM=y
CONFIG_TARGET_TS4900=y
CONFIG_DM=y
CONFIG_DM_THERMAL=y
```

## configs/ts4900-s-1g-800mhz-i_defconfig
```kconfig
CONFIG_SYS_EXTRA_OPTIONS="IMX_CONFIG=board/technologic/ts4900/ts4900-s-1g-800mhz-i.cfg,MX6DL,DDR_MB=1024,IMX_TYPE=\"ts4900-s-1g-800mhz-i\""
CONFIG_ARM=y
CONFIG_TARGET_TS4900=y
CONFIG_DM=y
CONFIG_DM_THERMAL=y
```

## configs/ts7100-512m_defconfig
```kconfig
CONFIG_SYS_EXTRA_OPTIONS="IMX_CONFIG=board/technologic/ts7100/imximage-512m.cfg,MX6UL,DDR_MB=512,IMX_TYPE=\"ts7100-512m\""
CONFIG_ARM=y
CONFIG_TARGET_TS7100=y
CONFIG_DM=y
CONFIG_DM_THERMAL=y
CONFIG_NET_RANDOM_ETHADDR=y
CONFIG_CMD_GPIO=y
CONFIG_CMD_DHCP=y
CONFIG_CMD_PING=y
CONFIG_SYS_PROMPT="U-Boot > "
CONFIG_TCP=y
CONFIG_CMD_WGET=y
```

## configs/ts7120-1g_defconfig
```kconfig
CONFIG_SYS_EXTRA_OPTIONS="IMX_CONFIG=board/technologic/ts7120/imximage-1g.cfg,MX6UL,DDR_MB=1024,IMX_TYPE=\"ts7120-1g\""
CONFIG_ARM=y
CONFIG_TARGET_TS7120=y
CONFIG_DM=y
CONFIG_DM_THERMAL=y
CONFIG_NET_RANDOM_ETHADDR=y
CONFIG_CMD_GPIO=y
CONFIG_CMD_DHCP=y
CONFIG_CMD_PING=y
CONFIG_SYS_PROMPT="U-Boot > "
```

## configs/ts7180-1g_defconfig
```kconfig
CONFIG_SYS_EXTRA_OPTIONS="IMX_CONFIG=board/technologic/ts7180/imximage-1g.cfg,MX6UL,DDR_MB=1024,IMX_TYPE=\"ts7180-1g\""
CONFIG_ARM=y
CONFIG_TARGET_TS7180=y
CONFIG_DM=y
CONFIG_DM_THERMAL=y
CONFIG_NET_RANDOM_ETHADDR=y
CONFIG_CMD_GPIO=y
CONFIG_CMD_DHCP=y
CONFIG_CMD_PING=y
CONFIG_SYS_PROMPT="U-Boot > "
```

## configs/ts7180-512m_defconfig
```kconfig
CONFIG_SYS_EXTRA_OPTIONS="IMX_CONFIG=board/technologic/ts7180/imximage-512m.cfg,MX6UL,DDR_MB=512,IMX_TYPE=\"ts7180-512m\""
CONFIG_ARM=y
CONFIG_TARGET_TS7180=y
CONFIG_DM=y
CONFIG_DM_THERMAL=y
CONFIG_NET_RANDOM_ETHADDR=y
CONFIG_CMD_GPIO=y
CONFIG_CMD_DHCP=y
CONFIG_CMD_PING=y
CONFIG_SYS_PROMPT="U-Boot > "
```

## configs/ts7180_defconfig
```kconfig
CONFIG_SYS_EXTRA_OPTIONS="IMX_CONFIG=board/technologic/ts7180/imximage.cfg,MX6UL"
CONFIG_ARM=y
CONFIG_TARGET_TS7180=y
CONFIG_DM=y
CONFIG_DM_THERMAL=y
CONFIG_NET_RANDOM_ETHADDR=y
CONFIG_CMD_GPIO=y
CONFIG_CMD_DHCP=y
CONFIG_CMD_PING=y
CONFIG_SYS_PROMPT="U-Boot > "
```

## configs/ts7970-q-2g-1000mhz-c_defconfig
```kconfig
CONFIG_SYS_EXTRA_OPTIONS="IMX_CONFIG=board/technologic/ts7970/ts7970-q-2g-1000mhz-c.cfg,MX6Q,DDR_MB=2048,IMX_TYPE=\"ts7970-q-2g-1000mhz-c\""
CONFIG_ARM=y
CONFIG_TARGET_TS7970=y
CONFIG_DM=y
CONFIG_DM_THERMAL=y
```

## configs/ts7970-q-4g-800mhz-i_defconfig
```kconfig
CONFIG_SYS_EXTRA_OPTIONS="IMX_CONFIG=board/technologic/ts7970/ts7970-q-4g-800mhz-i.cfg,MX6Q,DDR_MB=3840,IMX_TYPE=\"ts7970-q-4g-800mhz-i\""
CONFIG_ARM=y
CONFIG_TARGET_TS7970=y
CONFIG_DM=y
CONFIG_DM_THERMAL=y
```

## configs/ts7970-s-1g-800mhz-i_defconfig
```kconfig
CONFIG_SYS_EXTRA_OPTIONS="IMX_CONFIG=board/technologic/ts7970/ts7970-s-1g-800mhz-i.cfg,MX6DL,DDR_MB=1024,IMX_TYPE=\"ts7970-s-1g-800mhz-i\""
CONFIG_ARM=y
CONFIG_TARGET_TS7970=y
CONFIG_DM=y
CONFIG_DM_THERMAL=y
```
